## conf/layer.conf
```bitbake
# We have a conf and classes directory, add to BBPATH
BBPATH .= ":${LAYERDIR}"

# We have recipes-* directories, add to BBFILES
BBFILES += "${LAYERDIR}/recipes-*/*/*.bb ${LAYERDIR}/recipes-*/*/*.bbappend"

BBFILE_COLLECTIONS += "macchina-io"
BBFILE_PATTERN_macchina-io = "^${LAYERDIR}/"
BBFILE_PRIORITY_macchina-io = "1"

# This should only be incremented on significant changes that will
# cause compatibility issues with other layers
LAYERVERSION_macchina-io = "1"

LAYERDEPENDS_macchina-io = "core"

LAYERSERIES_COMPAT_macchina-io = "thud"
```
